## Documentation/devicetree/bindings/input/touchscreen/wacom,w9000-series.yaml
```yaml
# SPDX-License-Identifier: GPL-2.0
%YAML 1.2
---
$id: http://devicetree.org/schemas/input/touchscreen/wacom,w9007.yaml#
$schema: http://devicetree.org/meta-schemas/core.yaml#

title: Wacom W9000-series penabled I2C touchscreen driver

description:
  The W9000-series are penabled touchscreen controllers by Wacom.
  It is used in some Samsung Galaxy Tab devices from 2013 and 2014.

maintainers:
  - Hendrik Noack <hendrik.noack@protonmail.com>

properties:
  compatible:
    enum:
      - wacom,w9007a_lt03
      - wacom,w9007a_v1
      - wacom,w9010

  reg:
    maxItems: 1

  interrupts:
    maxItems: 1

  vdd-supply:
    description:
      Optional regulator for the VDD digital voltage.

  pdct-gpios:
    maxItems: 1
    description:
      Optional GPIO specifier for the touchscreen's pdct pin.

  flash-mode-gpios:
    maxItems: 1
    description:
      Optional GPIO specifier for the touchscreen's flash-mode pin.

  pen-inserted-gpios:
    maxItems: 1
    description:
      Optional GPIO specifier for the touchscreen's pen-insert pin.

  touchscreen-inverted-x:
    description: X axis is inverted
    type: boolean

  touchscreen-inverted-y:
    description: Y axis is inverted
    type: boolean

  touchscreen-swapped-x-y:
    description: X and Y axis are swapped
                 Swapping is done after inverting the axis
    type: boolean

  touchscreen-x-mm:
    description: horizontal length in mm of the touchscreen

  touchscreen-y-mm:
    description: vertical length in mm of the touchscreen


required:
  - compatible
  - reg
  - interrupts
  - vdd-supply

additionalProperties: false

examples:
  - |
    #include <dt-bindings/interrupt-controller/irq.h>
    #include <dt-bindings/gpio/gpio.h>
    i2c {
      #address-cells = <1>;
      #size-cells = <0>;
      digitizer@56 {
        compatible = "wacom,wacom,w9007a_v1";
        reg = <0x56>;
        interrupt-parent = <&gpx3>;
        interrupts = <5 IRQ_TYPE_EDGE_RISING>;

        vdd-supply = <&stylus_reg>;

        pdct-gpios = <&gpd1 2 GPIO_ACTIVE_HIGH>;
        flash-mode-gpios = <&gpd1 3 GPIO_ACTIVE_HIGH>;
        pen-inserted-gpios = <&gpx0 0 GPIO_ACTIVE_LOW>;

        touchscreen-x-mm = <262>;
        touchscreen-y-mm = <164>;
      };
    };
```

## Documentation/devicetree/bindings/power/supply/maxim,ds2784.yaml
```yaml
# SPDX-License-Identifier: GPL-2.0
%YAML 1.2
---
$id: http://devicetree.org/schemas/power/supply/maxim,ds2784.yaml#
$schema: http://devicetree.org/meta-schemas/core.yaml#

title: Maxim/Dallas DS2784 Stand-Alone Fuel Gauge IC

maintainers:
  - 

description: |
  The ds2784 is a w1 slave device and must hence have its sub-node in
  DT under a w1 bus master node.

allOf:
  - $ref: power-supply.yaml#

properties:
  compatible:
    const: maxim,ds2784

required:
  - compatible

unevaluatedProperties: false
```

## Documentation/devicetree/bindings/sound/audience,es305.yaml
```yaml
# SPDX-License-Identifier: (GPL-2.0-only OR BSD-2-Clause)
%YAML 1.2
---
$id: http://devicetree.org/schemas/sound/audience,es305.yaml#
$schema: http://devicetree.org/meta-schemas/core.yaml#

title: Audience ES305 Voice Processor

maintainers:
  - Alexandre Marquet <tb@a-marquet.fr>

properties:
  compatible:
    const: audience,es305

  reg:
    maxItems: 1

  clocks:
    maxItems: 1
    description: Master clock.

  clock-names:
    items:
      - const: MCLK

  '#clock-cells':
    const: 1

  reset-gpios:
    maxItems: 1
    description: Active high reset GPIO.

  device-wakeup-gpios:
    maxItems: 1
    description: Active high wake up GPIO.

required:
  - compatible
  - reg
  - clocks
  - clock-names
  - reset-gpios
  - device-wakeup-gpios

additionalProperties: false

examples:
  - |
    #include <dt-bindings/gpio/gpio.h>

    i2c {
        #address-cells = <1>;
        #size-cells = <0>;

        audio-codec@3e {
            compatible = "audience,es305";
            reg = <0x3e>;

            #clock-cells = <1>;
            clocks = <&es305_clock>;
            clock-names = "MCLK";

            reset-gpios = <&gpg0 4 GPIO_ACTIVE_HIGH>;
            device-wakeup-gpios = <&gpg0 3 GPIO_ACTIVE_HIGH>;
            pinctrl-0 = <&es305_reset &es305_wake>;
            pinctrl-names = "default";
        };
    };
```

## Documentation/devicetree/bindings/sound/samsung,nexus10-manta-audio.yaml
```yaml
# SPDX-License-Identifier: (GPL-2.0-only OR BSD-2-Clause)
%YAML 1.2
---
$id: http://devicetree.org/schemas/sound/samsung,nexus10-manta-audio.yaml#
$schema: http://devicetree.org/meta-schemas/core.yaml#

title: Samsung Manta (Nexus 10) audio complex

maintainers:
  - Alexandre Marquet <tb@a-marquet.fr>

allOf:
  - $ref: sound-card-common.yaml#

properties:
  compatible:
    const: samsung,nexus10-manta-audio

  samsung,aux-devs:
    description: Phandle pointing to the es305 voice processor.
    $ref: /schemas/types.yaml#/definitions/phandle-array

  samsung,audio-widgets:
    description: Audio sound widgets.
    $ref: /schemas/types.yaml#/definitions/non-unique-string-array

  samsung,pin-switches:
    description: The widget names for which pin switches must be created.
    $ref: /schemas/types.yaml#/definitions/string-array

  cpu:
    type: object
    additionalProperties: false
    properties:
      sound-dai:
        maxItems: 1
        description: Phandle to the I2S controller.
    required:
      - sound-dai

  codec:
    additionalProperties: false
    type: object
    properties:
      sound-dai:
        maxItems: 1
        description: phandle to the WM1811 codec.
    required:
      - sound-dai

required:
  - compatible
  - samsung,aux-devs
  - samsung,audio-widgets
  - samsung,pin-switches
  - cpu
  - codec

unevaluatedProperties: false

examples:
  - |
    #include <dt-bindings/gpio/gpio.h>

    sound {
        compatible = "samsung,nexus10-manta-audio";

        model = "Manta WM1811";
        samsung,aux-devs = <&es305>;
        audio-routing = 
            "HP", "HPOUT1L",
            "HP", "HPOUT1R",
            "SPK", "SPKOUTLN",
            "SPK", "SPKOUTLP",
            "SPK", "SPKOUTRN",
            "SPK", "SPKOUTRP",
            "3rd Mic", "MICBIAS1",
            "IN1LP", "3rd Mic",
            "IN1LN", "3rd Mic",
            "Headset Mic", "MICBIAS2",
            "IN1RP", "Headset Mic",
            "IN1RN", "Headset Mic",
            "2nd Mic", "MICBIAS2",
            "IN2LP:VXRN", "2nd Mic",
            "Main Mic", "MICBIAS2",
            "IN2RP:VXRP", "Main Mic",
            "AIF1DAC1L", "Port D OUT",
            "AIF1DAC1R", "Port D OUT",
            "Port A IN", "Playback Mixer",
            "Port A IN", "Playback Mixer";
        samsung,audio-widgets =
            "Headphone", "HP",
            "Speaker", "SPK",
            "Microphone", "Headset Mic",
            "Microphone", "Main Mic",
            "Microphone", "2nd Mic",
            "Microphone", "3rd Mic";
        samsung,pin-switches = "HP", "SPK";

        cpu {
            sound-dai = <&i2s0 0>;
        };
        codec {
            sound-dai = <&wm1811 0>;
        };
    };
```
